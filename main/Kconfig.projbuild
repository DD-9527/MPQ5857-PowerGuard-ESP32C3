## main/Kconfig.projbuild
```kconfig
menu "Board IO Configuration"

    orsource "$IDF_PATH/examples/common_components/env_caps/$IDF_TARGET/Kconfig.env_caps"
    # 上面这行提供 ENV_GPIO_RANGE_MIN / ENV_GPIO_OUT_RANGE_MAX
    # 如果提示找不到，直接删掉，然后把下面 range 写成 0 48 即可

    comment "Digital Outputs"
    config GPIO_EN1
        int "EN1 GPIO"
        range ENV_GPIO_RANGE_MIN ENV_GPIO_OUT_RANGE_MAX
        default 7
        help
            GPIO for EN1 (active high enable).

    config GPIO_EN2
        int "EN2 GPIO"
        range ENV_GPIO_RANGE_MIN ENV_GPIO_OUT_RANGE_MAX
        default 8
        help
            GPIO for EN2 (active high enable).

    config GPIO_BUZZER
        int "Buzzer GPIO"
        range ENV_GPIO_RANGE_MIN ENV_GPIO_OUT_RANGE_MAX
        default 6
        help
            GPIO that drives the buzzer.

    comment "Digital Inputs"
    config GPIO_FAULT
        int "FAULT GPIO"
        range ENV_GPIO_RANGE_MIN ENV_GPIO_OUT_RANGE_MAX
        default 2
        help
            Fault indicator input (active low).

    comment "Analog Inputs"
    config GPIO_ISNS
        int "ISNS GPIO (ADC)"
        range ENV_GPIO_RANGE_MIN ENV_GPIO_OUT_RANGE_MAX
        default 0
        help
            Current sense (ADC1 channel).

    config GPIO_VSNS
        int "VSNS GPIO (ADC)"
        range ENV_GPIO_RANGE_MIN ENV_GPIO_OUT_RANGE_MAX
        default 1
        help
            Voltage sense (ADC1 channel).

    menu "I²C Pins"
        config GPIO_I2C_SCL
            int "SCL GPIO"
            range ENV_GPIO_RANGE_MIN ENV_GPIO_OUT_RANGE_MAX
            default 4
            help
                I²C clock line.
        config GPIO_I2C_SDA
            int "SDA GPIO"
            range ENV_GPIO_RANGE_MIN ENV_GPIO_OUT_RANGE_MAX
            default 5
            help
                I²C data line.
    endmenu

endmenu
```
